## Kconfig
```kconfig
menuconfig FB_TFT
	tristate "Support for small TFT LCD display modules"
	depends on FB && SPI && GPIOLIB
	select FB_SYS_FILLRECT
	select FB_SYS_COPYAREA
	select FB_SYS_IMAGEBLIT
	select FB_SYS_FOPS
	select FB_DEFERRED_IO
	select FB_BACKLIGHT

config FB_TFT_HX8340BN
	tristate "FB driver for the HX8340BN LCD Controller"
	depends on FB_TFT
	help
	  Generic Framebuffer support for HX8340BN

config FB_TFT_HX8347D
	tristate "FB driver for the HX8347D LCD Controller"
	depends on FB_TFT
	help
	  Generic Framebuffer support for HX8347D

config FB_TFT_ILI9320
	tristate "FB driver for the ILI9320 LCD Controller"
	depends on FB_TFT
	help
	  Generic Framebuffer support for ILI9320

config FB_TFT_ILI9325
	tristate "FB driver for the ILI9325 LCD Controller"
	depends on FB_TFT
	help
	  Generic Framebuffer support for ILI9325

config FB_TFT_ILI9341
	tristate "FB driver for the ILI9341 LCD Controller"
	depends on FB_TFT
	help
	  Generic Framebuffer support for ILI9341

config FB_TFT_PCD8544
	tristate "FB driver for the PCD8544 LCD Controller"
	depends on FB_TFT
	help
	  Generic Framebuffer support for PCD8544

config FB_TFT_SSD1289
	tristate "FB driver for the SSD1289 LCD Controller"
	depends on FB_TFT
	help
	  Framebuffer support for SSD1289

config FB_TFT_SSD1331
	tristate "FB driver for the SSD1331 LCD Controller"
	depends on FB_TFT
	help
	  Framebuffer support for SSD1331

config FB_TFT_SSD1351
	tristate "FB driver for the SSD1351 LCD Controller"
	depends on FB_TFT
	help
	  Framebuffer support for SSD1351

config FB_TFT_ST7735R
	tristate "FB driver for the ST7735R LCD Controller"
	depends on FB_TFT
	help
	  Generic Framebuffer support for ST7735R

config FB_TFT_WATTEROTT
	tristate "FB driver for the WATTEROTT LCD Controller"
	depends on FB_TFT
	help
	  Generic Framebuffer support for WATTEROTT

config FB_FLEX
	tristate "Generic FB driver for TFT LCD displays"
	depends on FB_TFT
	help
	  Generic Framebuffer support for TFT LCD displays.

config FB_TFT_FBTFT_DEVICE
	tristate "Module to for adding FBTFT devices"
	depends on FB_TFT
```
